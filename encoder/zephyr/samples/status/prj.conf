## CMakeLists.txt
```
cmake_minimum_required(VERSION 3.20.0)

# Build with -DEXTRA_ZEPHYR_MODULES=<repo>/encoder/zephyr to find the led_talks module.
find_package(Zephyr REQUIRED HINTS $ENV{ZEPHYR_BASE})
project(led_talks_status)

target_sources(app PRIVATE src/main.c)
```

## prj.conf
```kconfig
CONFIG_GPIO=y
CONFIG_LED_TALKS=y
```

## boards/promicro_nrf52840_nrf52840_uf2.overlay
```dts
/* Pro Micro nRF52840: the board has led0 (P0.15) but no button. Wire a button from P0.17 to
 * GND, as iphone-remote's fob does. */
/ {
	buttons {
		compatible = "gpio-keys";

		button0: button_0 {
			gpios = <&gpio0 17 (GPIO_ACTIVE_LOW | GPIO_PULL_UP)>;
			label = "Status button";
		};
	};

	aliases {
		sw0 = &button0;
	};
};
```

## src/main.c
```c
/* Press the button: blink a status report on the LED, in OOK. */
#include <stdio.h>

#include <zephyr/kernel.h>

#include "led_talks_zephyr.h"

#define REPEATS 3
#define PERIOD_US LT_ZEPHYR_DEFAULT_PERIOD_US

static const struct gpio_dt_spec led = GPIO_DT_SPEC_GET(DT_ALIAS(led0), gpios);
static const struct gpio_dt_spec button = GPIO_DT_SPEC_GET(DT_ALIAS(sw0), gpios);

static size_t build_status(uint8_t *buf, size_t cap)
{
	lt_status_t st;

	lt_status_init(&st, buf, cap);
	lt_status_str(&st, LT_TAG_DEVICE, "led-talks sample");
	lt_status_u32(&st, LT_TAG_UPTIME, (uint32_t)(k_uptime_get() / 1000));
	lt_status_str(&st, LT_TAG_STATE, "ok");
	return lt_status_len(&st);
}

int main(void)
{
	if (lt_zephyr_init_gpio(&led, PERIOD_US) != 0 || !gpio_is_ready_dt(&button) ||
	    gpio_pin_configure_dt(&button, GPIO_INPUT) != 0) {
		printk("LED or button not ready\n");
		return 0;
	}
	printk("press the button to blink a status report\n");

	for (;;) {
		k_msleep(20);
		if (gpio_pin_get_dt(&button) <= 0 || lt_zephyr_busy()) {
			continue;
		}
		uint8_t buf[LT_MAX_PAYLOAD];
		size_t len = build_status(buf, sizeof(buf));

		if (len == 0 || lt_zephyr_send(buf, len, true) != 0) {
			printk("could not send status\n");
			continue;
		}
		/* Stop in the third frame's gap, so no fourth one begins. */
		int64_t symbols = (int64_t)lt_zephyr_repeat_symbols(len) * REPEATS -
				  LT_ZEPHYR_GAP_SYMBOLS / 2;

		k_msleep((int32_t)(symbols * PERIOD_US / 1000));
		lt_zephyr_stop();

		while (gpio_pin_get_dt(&button) > 0) {
			k_msleep(20); /* wait for release */
		}
	}
}
```
